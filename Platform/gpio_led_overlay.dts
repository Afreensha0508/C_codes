/dts-v1/;
/plugin/;

/ {
	compatible = "brcm,bcm2711";
	
	fragment@0 {
		target-path = "/";
		__overlay__ {
			gpio_led_node: gpio_led@0 {
				compatible = "rpi,gpio_led_blink";
				status="okay";
				gpios = <&gpio 17 0>;
				gpio-names = "led";
			};
		};
	};
};
