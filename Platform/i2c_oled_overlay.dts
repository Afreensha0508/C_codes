/dts-v1/;
/plugin/;




/ {
    fragment@0 {
        target = <&i2c1>;
        __overlay__ {
            #address-cells = <1>;
            #size-cells = <0>;

            ssd1306@3c {
                compatible = "my_i2c,ssd1306";
                reg = <0x3c>;
                status = "okay";
            };
        };
    };
};
